## modules/nunchuk/Kconfig
```kconfig
# SPDX-License-Identifier: Apache-2.0

# Main driver enable option
config NUNCHUK_DRIVER
	bool "Nintendo Nunchuk I2C driver"
	depends on I2C && INPUT  # ← Use depends instead of select
	help
	  Enable Nintendo Nunchuk I2C input driver support.

if NUNCHUK_DRIVER

config NUNCHUK_INIT_PRIORITY
	int "Nunchuk driver initialization priority"
	default 90
	range 70 99
	help
	  Driver initialization priority. Must be higher than I2C.

config NUNCHUK_THREAD_STACK_SIZE
	int "Stack size for nunchuk work handler"
	default 1536
	range 1024 4096
	help
	  Stack size for the work queue that handles nunchuk polling.
	  Default 1536 bytes provides room for I2C operations and callbacks.

config NUNCHUK_GESTURES
	bool "Enable gesture detection"
	depends on FPU
	default y if FPU
	help
	  Enable accelerometer-based gesture detection.
	  Requires FPU for floating-point calculations.

config NUNCHUK_LOG_LEVEL
	int "Nunchuk driver log level"
	depends on LOG
	default 3
	range 0 4
	help
	  0=OFF, 1=ERROR, 2=WARNING, 3=INFO, 4=DEBUG

endif # NUNCHUK_DRIVER
```

## modules/nunchuk/dts/bindings/input/nintendo,nunchuk.yaml
```yaml
# SPDX-License-Identifier: Apache-2.0

description: Nintendo Wii Nunchuk I2C input device with extended features

compatible: "nintendo,nunchuk-extended"

include: i2c-device.yaml

properties:
  poll-interval-ms:
    type: int
    default: 20
    description: |
      Polling interval in milliseconds for reading sensor data.
      Typical range: 10-50ms. Lower values = more responsive but higher CPU usage.

  deadzone:
    type: int
    default: 15
    description: |
      Joystick deadzone radius (0-127). Joystick movements within this distance
      from center (127,127) are ignored to reduce noise and drift.

  nunchuk-type:
    type: string
    default: "white"
    enum:
      - "black"
      - "white"
    description: |
      Nunchuk variant type:
      - "black": Original Nunchuk (init: 0xF0,0x55 then 0xFB,0x00)
      - "white": Newer Nunchuk (init: 0x40,0x00 then 0x00)

  enable-gestures:
    type: boolean
    description: |
      Enable gesture detection using accelerometer data.
      Detects shakes and tilts. Requires FPU support.
```

## modules/nunchuk/zephyr/Kconfig
```kconfig
# SPDX-License-Identifier: Apache-2.0

# Include the main Kconfig from parent directory
rsource "../Kconfig"
```
