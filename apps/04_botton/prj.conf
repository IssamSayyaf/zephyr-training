## CMakeLists.txt
```
# SPDX-License-Identifier: Apache-2.0

# Specify minimum CMake version required
cmake_minimum_required(VERSION 3.20.0)

# Set the target board to Raspberry Pi Pico
set(BOARD nrf52840dk/nrf52840)
# Specify the Device Tree overlay file that contains custom board configurations
set(DTC_OVERLAY_FILE "board/app.overlay")

# Find and include the Zephyr package which provides build system integration
# REQUIRED ensures CMake will error if Zephyr isn't found
# HINTS tells CMake where to look for Zephyr using the ZEPHYR_BASE environment variable
find_package(Zephyr REQUIRED HINTS $ENV{ZEPHYR_BASE})

# Define the project name
project(ZEPHYR_APP_1)

# Add the main application source file
target_sources(app PRIVATE src/main.c)

# Add the button driver source files
# target_sources(app PRIVATE
#     drivers/button/src/button_driver.c
# )

# Add the driver include directory
# target_include_directories(app PRIVATE drivers/button/include)
```

## Kconfig
```
source "Kconfig.zephyr"

# rsource "drivers/button/Kconfig" 
```

## prj.conf
```kconfig
# CONFIG_GPIO=y
# CONFIG_LOG=y
# CONFIG_LOG_DEFAULT_LEVEL=3
# CONFIG_LOG_BACKEND_UART=y
# CONFIG_SERIAL=y
# CONFIG_UART_CONSOLE=y
# # CONFIG_BUTTON_DRIVER=y
```

## src/main.c
```c
/*
 * Copyright (c) 2016 Intel Corporation
 *
 * SPDX-License-Identifier: Apache-2.0
 */

#include <stdio.h>
#include <zephyr/kernel.h>
#include <zephyr/drivers/gpio.h>

/* 1000 msec = 1 sec */
#define SLEEP_TIME_MS   1000

/* The devicetree node identifier for the "led0" alias. */
#define LED0_NODE DT_ALIAS(led0)
#define BUTTON0_NODE DT_ALIAS(button6)
/*
 * A build error on this line means your board is unsupported.
 * See the sample documentation for information on how to fix this.
 */
static const struct gpio_dt_spec led = GPIO_DT_SPEC_GET(LED0_NODE, gpios);
static const struct gpio_dt_spec button = GPIO_DT_SPEC_GET(BUTTON0_NODE, gpios);

int main(void)
{
	int ret;
	bool led_state = true;

	if (!gpio_is_ready_dt(&led)) {
		return 0;
	}

	ret = gpio_pin_configure_dt(&led, GPIO_OUTPUT_ACTIVE);
	if (ret < 0) {
		return 0;
	}
	if (!gpio_is_ready_dt(&button)) {
		return 0;
	}
	ret = gpio_pin_configure_dt(&button, GPIO_INPUT);
	if (ret < 0) {
		return 0;
	}
	while (1) {
		if (gpio_pin_get_dt(&button) == 0) {
			k_msleep(10);
			if (gpio_pin_get_dt(&button) == 0) {
				led_state = !led_state;
				ret = gpio_pin_set_dt(&led, (int)led_state);
				if (ret < 0) {
					return 0;
				}
				printf("LED state: %s\n", led_state ? "ON" : "OFF");
				while (gpio_pin_get_dt(&button) == 0) {
					k_msleep(10);
				}
			}
		}
	}
	return 0;
}
```
