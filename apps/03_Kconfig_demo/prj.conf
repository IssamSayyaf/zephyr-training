## CMakeLists.txt
```
# SPDX-License-Identifier: Apache-2.0

# Specify minimum CMake version required
cmake_minimum_required(VERSION 3.20.0)

# Set the target board to Raspberry Pi Pico
set(BOARD nrf52840dk/nrf52840)
# Specify the Device Tree overlay file that contains custom board configurations
# set(DTC_OVERLAY_FILE "board/app.overlay")
# set(EXTRA_CONF_FILE board/nrf_config.conf)
set(ZEPHYR_EXTRA_MODULES "${CMAKE_SOURCE_DIR}/../../modules/say_hello")
# Find and include the Zephyr package which provides build system integration
# REQUIRED ensures CMake will error if Zephyr isn't found
# HINTS tells CMake where to look for Zephyr using the ZEPHYR_BASE environment variable
find_package(Zephyr REQUIRED HINTS $ENV{ZEPHYR_BASE})


# Name the project
project(random_number_generator)

# Include the library (via directory)
# add_subdirectory(lib/say_hello)

# Locate the source code for the application
# Assumes add_executable(app "")
target_sources(app PRIVATE src/main.c)

# Link the say_hello library to the application
# target_link_libraries(app PRIVATE hello_lib)
```

## prj.conf
```kconfig
# Enable our custom module
CONFIG_SAY_HELLO=y

# Enable floating point printf (for printing random numbers)
CONFIG_PICOLIBC_IO_FLOAT=y

# Enable random number generator
CONFIG_ENTROPY_GENERATOR=y
CONFIG_TEST_RANDOM_GENERATOR=y
```

## src/main.c
```c
#include <zephyr/random/random.h>

#ifdef CONFIG_SAY_HELLO
#include "say_hello.h"
#endif

// Settings
static const int32_t sleep_time_ms = 1000;

int main(void)
{
    uint32_t rnd;
    double rnd_float;
    // Do forever
    while (1) {

        // Print random number
        rnd = sys_rand32_get();
        rnd_float = (double)rnd / (UINT32_MAX + 1.0);
		printk("Random number: %.3f\r\n", rnd_float);
        // printk("Random value: %u\r\n", rnd);

#ifdef CONFIG_SAY_HELLO
        say_hello();
#endif

        // Sleep
        k_msleep(sleep_time_ms);
    }

    return 0;
}
```
