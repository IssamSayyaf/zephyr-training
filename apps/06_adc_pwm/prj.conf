## CMakeLists.txt
```
# SPDX-License-Identifier: Apache-2.0

# Specify minimum CMake version required
cmake_minimum_required(VERSION 3.20.0)

# Set the target board to Raspberry Pi Pico
set(BOARD nrf52840dk/nrf52840)
# Specify the Device Tree overlay file that contains custom board configurations
set(DTC_OVERLAY_FILE "board/app.overlay")

# Find and include the Zephyr package which provides build system integration
# REQUIRED ensures CMake will error if Zephyr isn't found
# HINTS tells CMake where to look for Zephyr using the ZEPHYR_BASE environment variable
find_package(Zephyr REQUIRED HINTS $ENV{ZEPHYR_BASE})

# Define the project name
project(adc)

# Add the main application source file
target_sources(app PRIVATE src/main.c)

# Add the button driver source files
# target_sources(app PRIVATE
#     drivers/button/src/button_driver.c
# )

# Add the driver include directory
# target_include_directories(app PRIVATE drivers/button/include)
```

## prj.conf
```kconfig
CONFIG_ADC=y
CONFIG_GPIO=y
CONFIG_LOG=y
CONFIG_LOG_DEFAULT_LEVEL=3
CONFIG_LOG_BACKEND_UART=y
CONFIG_SERIAL=y
CONFIG_UART_CONSOLE=y
# CONFIG_ADC=y
# CONFIG_PWM=y
CONFIG_PWM=y
CONFIG_PWM_NRFX=y
# # CONFIG_BUTTON_DRIVER=y
```

## src/main.c
```c
#include <stdio.h>
#include <zephyr/kernel.h>
#include <zephyr/drivers/adc.h>
#include <zephyr/drivers/pwm.h>

// Settings
static const int32_t sleep_time_ms = 100;

// Get Devicetree configurations
#define MY_ADC_CH DT_ALIAS(my_adc_channel)
#define MY_ADC DT_ALIAS(my_adc)
#define MY_PWM DT_ALIAS(pwm_led0)

static const struct device *adc = DEVICE_DT_GET(MY_ADC);
static const struct adc_channel_cfg adc_ch = ADC_CHANNEL_CFG_DT(MY_ADC_CH);
static const struct pwm_dt_spec pwm_led = PWM_DT_SPEC_GET(MY_PWM);

#define VDD_MV 3000

int main(void)
{
	int ret;
	uint16_t buf;
	uint16_t val_mv;
	uint32_t pulse_ns;

	// Buffer and options for ADC (defined in adc.h)
	struct adc_sequence seq = {
		.channels = BIT(adc_ch.channel_id),
		.buffer = &buf,
		.buffer_size = sizeof(buf),
		.resolution = DT_PROP(MY_ADC_CH, zephyr_resolution)
	};

	// Make sure that the ADC was initialized
	if (!device_is_ready(adc)) {
		printk("ADC peripheral is not ready\r\n");
		return 0;
	}

	// Configure ADC channel
	ret = adc_channel_setup(adc, &adc_ch);
	if (ret < 0) {
		printk("Could not set up ADC\r\n");
		return 0;
	}

	// Make sure that the PWM LED was initialized
	if (!pwm_is_ready_dt(&pwm_led)) {
		printk("PWM is not ready\r\n");
		return 0;
	}

	// Do forever
	while (1) {
		// Sample ADC
		ret = adc_read(adc, &seq);
		if (ret < 0) {
			printk("Could not read ADC: %d\r\n", ret);
			continue;
		}

		// Calculate ADC value (mV)
		val_mv = buf * VDD_MV / (1 << seq.resolution);

		// Calculate pulse width proportional to ADC reading
		// Scale ADC value (0 to max_resolution) to pulse width (0 to period)
		pulse_ns = ((uint64_t)buf * pwm_led.period) / (1 << seq.resolution);

		// Print ADC value
		printk("Raw: %u, mV: %u\r\n", buf, val_mv);
		printk("Pulse: %u ns\r\n", pulse_ns);

		// Set LED PWM pulse width
		ret = pwm_set_dt(&pwm_led, pwm_led.period, pulse_ns);
		if (ret) {
			printk("Error %d: failed to set pulse width\n", ret);
			return 0;
		}

		// Sleep
		k_msleep(sleep_time_ms);
	}
	return 0;
}
```
