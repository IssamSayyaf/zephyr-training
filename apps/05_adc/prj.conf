## prj.conf
```kconfig
CONFIG_ADC=y
CONFIG_GPIO=y
CONFIG_LOG=y
CONFIG_LOG_DEFAULT_LEVEL=3
CONFIG_LOG_BACKEND_UART=y
CONFIG_SERIAL=y
CONFIG_UART_CONSOLE=y
# # CONFIG_BUTTON_DRIVER=y
```

## src/main.c
```c
#include <stdio.h>
#include <zephyr/kernel.h>
#include <zephyr/drivers/adc.h>

// Settings
static const int32_t sleep_time_ms = 100;

// Get Devicetree configurations
#define MY_ADC_CH DT_ALIAS(my_adc_channel)
#define MY_ADC DT_ALIAS(my_adc)

static const struct device *adc = DEVICE_DT_GET(MY_ADC);
static const struct adc_channel_cfg adc_ch = ADC_CHANNEL_CFG_DT(MY_ADC_CH);
#define VDD_MV 3000
int main(void)
{
    int ret;
    uint16_t buf;
    uint16_t val_mv;
    // int32_t vref_mv;

    // Get Vref (mV) from Devicetree property
    // vref_mv = DT_PROP(MY_ADC_CH, zephyr_reference);

    // Buffer and options for ADC (defined in adc.h)
    struct adc_sequence seq = {
        .channels = BIT(adc_ch.channel_id),
        .buffer = &buf,
        .buffer_size = sizeof(buf),
        .resolution = DT_PROP(MY_ADC_CH, zephyr_resolution)
    };

    // Make sure that the ADC was initialized
    if (!device_is_ready(adc)) {
        printk("ADC peripheral is not ready\r\n");
        return 0;
    }

    // Configure ADC channel
    ret = adc_channel_setup(adc, &adc_ch);
    if (ret < 0) {
        printk("Could not set up ADC\r\n");
        return 0;
    }

    // Do forever
    while (1) {

        // Sample ADC
        ret = adc_read(adc, &seq);
        if (ret < 0) {
            printk("Could not read ADC: %d\r\n", ret);
            continue;
        }

        // Calculate ADC value (mV)
        val_mv = buf * VDD_MV / (1 << seq.resolution);

        // Print ADC value
        printk("Raw: %u, mV: %u\r\n", buf, val_mv);

        // Sleep
        k_msleep(sleep_time_ms);
    }
}
```
